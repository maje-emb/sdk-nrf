## applications/machine_learning/sample.yaml
```yaml
sample:
  name: nRF Machine Learning
  description: Machine learning application reference design
tests:
  applications.machine_learning.zdebug:
    build_only: true
    platform_allow: >
      nrf52840dk/nrf52840 thingy53/nrf5340/cpuapp thingy53/nrf5340/cpuapp/ns
      nrf5340dk/nrf5340/cpuapp
    integration_platforms:
      - nrf52840dk/nrf52840
      - thingy53/nrf5340/cpuapp
      - thingy53/nrf5340/cpuapp/ns
      - nrf5340dk/nrf5340/cpuapp
    tags: ci_build
  applications.machine_learning.zdebug_nus:
    build_only: true
    platform_allow: nrf52840dk/nrf52840
    integration_platforms:
      - nrf52840dk/nrf52840
    tags: ci_build
    extra_args: CONF_FILE=prj_nus.conf
  applications.machine_learning.zdebug_rtt:
    build_only: true
    platform_allow: thingy53/nrf5340/cpuapp thingy53/nrf5340/cpuapp/ns
    integration_platforms:
      - thingy53/nrf5340/cpuapp
      - thingy53/nrf5340/cpuapp/ns
    tags: ci_build
    extra_args: CONF_FILE=prj_rtt.conf
  applications.machine_learning.zrelease:
    build_only: true
    platform_allow: nrf52840dk/nrf52840 thingy53/nrf5340/cpuapp thingy53/nrf5340/cpuapp/ns
    integration_platforms:
      - nrf52840dk/nrf52840
      - thingy53/nrf5340/cpuapp
      - thingy53/nrf5340/cpuapp/ns
    tags: ci_build
    extra_args: CONF_FILE=prj_release.conf
  applications.machine_learning.sensor_hub.zdebug.singlecore:
    build_only: true
    sysbuild: true
    platform_allow: nrf54h20dk/nrf54h20/cpuapp
    integration_platforms:
      - nrf54h20dk/nrf54h20/cpuapp
    tags: ci_build
    extra_args: FILE_SUFFIX="singlecore"
  applications.machine_learning.sensor_hub.zdebug:
    build_only: true
    sysbuild: true
    platform_allow: nrf54h20dk/nrf54h20/cpuapp
    integration_platforms:
      - nrf54h20dk/nrf54h20/cpuapp
    tags: ci_build
    extra_args:
      SB_CONFIG_ML_APP_INCLUDE_REMOTE_IMAGE=y
      machine_learning_SNIPPET=nordic-ppr
```
