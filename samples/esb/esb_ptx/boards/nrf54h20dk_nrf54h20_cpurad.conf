## samples/esb/esb_ptx/boards/nrf54l15dk_nrf54l15_cpuapp.conf
```kconfig
#
# Copyright (c) 2025 Nordic Semiconductor
#
# SPDX-License-Identifier: LicenseRef-Nordic-5-Clause
#

# Enable DPPI driver
CONFIG_NRFX_DPPI10=y

CONFIG_NRFX_GPIOTE20=y
CONFIG_NRFX_GPPI=y
CONFIG_NRFX_DPPI20=y
```
